## config/west.yml
```yaml
manifest:
  remotes:
    - name: zmkfirmware
      url-base: https://github.com/zmkfirmware
    - name: urob
      url-base: https://github.com/urob

  projects:
    - name: zmk
      remote: zmkfirmware
      revision: zephyr-v3.5
      import: app/west.yml
    - name: zmk-unicode
      remote: urob
      revision: zephyr-v3.5

  self:
    path: config
```
